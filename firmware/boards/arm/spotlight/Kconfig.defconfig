## firmware/boards/arm/spotlight/Kconfig.defconfig
```kconfig
if BOARD_SPOTLIGHT

config BOARD
	default "spotlight"

config BT_CTLR
	default BT

endif
```

## firmware/boards/arm/spotlight/spotlight_defconfig
```kconfig
CONFIG_SOC_SERIES_NRF52X=y
CONFIG_SOC_NRF52832_QFAA=y
CONFIG_BOARD_SPOTLIGHT=y
CONFIG_ARM_MPU=y
CONFIG_HW_STACK_PROTECTION=y
CONFIG_INIT_STACKS=y
CONFIG_CONSOLE=y
CONFIG_GPIO=y
```

## firmware/boards/balto/spotlight/spotlight_defconfig
```kconfig
CONFIG_ARM_MPU=y
CONFIG_HW_STACK_PROTECTION=y
CONFIG_INIT_STACKS=y
CONFIG_CONSOLE=y
CONFIG_GPIO=y
```
